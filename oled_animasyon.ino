/*
 Author:	emirhan
*/
#include <EEPROM.h>
#include <OLED_I2C.h>

OLED ekran(SDA, SCL);
extern uint8_t SmallFont[];
extern uint8_t kedi_anim1[];
extern uint8_t kedi_anim2[];
extern uint8_t kedi_anim3[];
extern uint8_t kedi_anim4[];

const byte d1 = 13;
const byte d2 = 13;

int8_t anim_sayac = 0;

#define joy_x A0  // sag icin '< 2' sol icin '> 2'
#define joy_y A1  // yukari icin '>8 ' asagi icin '<8'
#define buzzer 11
#define joy_but 4  //on icin '5' off icin '0' \

////////////////////////////////////////////////////////////////////////////////////////////////////////////////////////////////////////////////////////////////////////////////
///////////////////////////////////////////////////////////////////////////////////////////////////////       setup     ////////////////////////////////////////////////////////
////////////////////////////////////////////////////////////////////////////////////////////////////////////////////////////////////////////////////////////////////////////////
void setup() {
  Serial.begin(9600);
  if (!ekran.begin(SSD1306_128X64))while(1); 
 
}
////////////////////////////////////////////////////////////////////////////////////////////////////////////////////////////////////////////////////////////////////////////////
///////////////////////////////////////////////////////////////////////////////////////////////////////       loop      ////////////////////////////////////////////////////////
////////////////////////////////////////////////////////////////////////////////////////////////////////////////////////////////////////////////////////////////////////////////
void loop() {
byte x = map(analogRead(joy_x),0,1023,0,5);

if(x < 2 || x > 2){
 if(anim_sayac == 3){ anim_sayac = 0;}else{anim_sayac++;} animasyon_kontrol(); delay(100);
}

}
void animasyon_kontrol()
{
  ekran.clrScr();
  if(anim_sayac == 0){ ekran.drawBitmap(42+d1, d2, kedi_anim1, 42, 34); }
    else if(anim_sayac == 1){ ekran.drawBitmap(39+d1, d2, kedi_anim2, 39, 37); }
      else if(anim_sayac == 2){ ekran.drawBitmap(31+d1, d2, kedi_anim3, 31, 39); }
        else if(anim_sayac == 3){ ekran.drawBitmap(37+d1, d2, kedi_anim4, 37, 32); }
        ekran.update();
}